## config-overrides/defconfig
```kconfig
BR2_ROOTFS_OVERLAY="../../src" # Copy files from src to the root of the image.

BR2_TARGET_GENERIC_HOSTNAME="car" # The hostname.
BR2_TARGET_GENERIC_ISSUE="Welcome to your very speedy racecar!" # The message that shows before all the logs when booting.

BR2_TARGET_GENERIC_ROOT_PASSWD="racer" # The root password.

BR2_ROOTFS_USERS_TABLES="../../config-overrides/users.txt" # The fule for other users.
BR2_PACKAGE_SUDO=y # Install sudo.

# --- Some usefull apps --
BR2_PACKAGE_NEOFETCH=y
BR2_PACKAGE_HTOP=y
BR2_PACKAGE_OPENSSH=y
BR2_PACKAGE_OPENSSL=y
BR2_PACKAGE_NANO=y

# -- Fix qemu ---
BR2_TARGET_ROOTFS_EXT2_SIZE="512M"


# --- Some pi stuff ---
BR2_PACKAGE_RPI_FIRMWARE_CONFIG_FILE="../../config-overrides/config.txt"

# --- Matchbox desktop ---
BR2_PACKAGE_MATCHBOX=y
BR2_PACKAGE_XORG7=y
BR2_PACKAGE_FONTCONFIG=y
BR2_PACKAGE_EXPAT=y
BR2_PACKAGE_MATCHBOX_LIB=y
BR2_PACKAGE_MATCHBOX_COMMON=y
BR2_PACKAGE_MATCHBOX_DESKTOP=y
BR2_PACKAGE_MATCHBOX_KEYBOARD=y
BR2_PACKAGE_LIBPNG=y
BR2_PACKAGE_XLIB_LIBXTST=y
BR2_PACKAGE_XLIB_LIBXRENDER=y
BR2_PACKAGE_XLIB_LIBXFT=y
BR2_PACKAGE_MATCHBOX_FAKEKEY=y
BR2_PACKAGE_MATCHBOX_PANEL=y
BR2_PACKAGE_XAPP_XINIT=y
BR2_PACKAGE_XSERVER_XORG_SERVER=y
BR2_PACKAGE_XDRIVER_XF86_VIDEO_FBDEV=y
BR2_PACKAGE_LIBDRM_VC4=y
BR2_PACKAGE_RPI_FIRMWARE_INSTALL_DTB_OVERLAYS=y
BR2_LINUX_KERNEL_DTB_OVERLAY_SUPPORT=y

# --- Idk if these are required. ---
BR2_PACKAGE_MCOOKIE=y
BR2_PACKAGE_XAPP_XAUTH=y


# --- fluxbox? ---
BR2_PACKAGE_FLUXBOX=y
BR2_PACKAGE_XAPP_XMODMAP=y





# --- Fix touchsceen? ---
BR2_PACKAGE_RPI_FIRMWARE_INSTALL_DTB_OVERLAYS=y
BR2_PACKAGE_RPI_FIRMWARE=y
BR2_PACKAGE_RPI_FIRMWARE_INSTALL_DTBS=y
BR2_LINUX_KERNEL_DTB_OVERLAY_SUPPORT=y
```

## configs/rpi3_defconfig
```kconfig
BR2_arm=y
BR2_cortex_a7=y
BR2_ARM_EABIHF=y

BR2_ARM_CPU_HAS_VFPV3=y
BR2_ARM_CPU_HAS_NEON=y

BR2_PACKAGE_RPI_FIRMWARE=y
BR2_PACKAGE_RPI_FIRMWARE_INSTALL_DTBS=y
BR2_PACKAGE_RPI_FIRMWARE_INSTALL_DTB_OVERLAYS=y
# BR2_PACKAGE_RPI_FIRMWARE_CONFIG_FILE="board/rpi3/config.txt"

BR2_TARGET_ROOTFS_EXT2=y
BR2_TARGET_ROOTFS_EXT2_4=y
BR2_TARGET_ROOTFS_RPI=y

BR2_LINUX_KERNEL=y
BR2_LINUX_KERNEL_CUSTOM_REPO_URL="https://github.com/raspberrypi/linux.git"
BR2_LINUX_KERNEL_CUSTOM_REPO_VERSION="rpi-6.6.y"
BR2_LINUX_KERNEL_DEFCONFIG="bcm2709"

BR2_LINUX_KERNEL=y
BR2_LINUX_KERNEL_DEFCONFIG="bcm2709"
```
